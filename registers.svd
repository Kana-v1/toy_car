# STM32F303 register map
File version: 1.4
CPU: CM4 r1p0, little endian, no MPU, no FPU, 4 interrupt priority bits
Registers are 32-bit, read-write, reset 0x0 unless marked. A register's access mark holds for its fields unless they carry their own. Offsets are from the block's base; lines under a group give offsets from that group; [hi:lo] are bit positions; {n}, {i} and the like mark numbered series; 'fields as' and 'values as' point back to an identical list; <NAME> marks a mode.

## Memory map
0x40000000 TIM2 size 0x400 — General purpose timer
0x40000400 TIM3 size 0x400 — General purpose timer
0x40000800 TIM4 size 0x400
0x40001000 TIM6 size 0x400 — Basic timers
0x40001400 TIM7 size 0x400
0x40002800 RTC size 0x400 — Real-time clock
0x40002C00 WWDG size 0x400 — Window watchdog
0x40003000 IWDG size 0x400 — Independent watchdog
0x40003400 I2S2ext size 0x400
0x40003800 SPI2 size 0x400
0x40003C00 SPI3 size 0x400
0x40004000 I2S3ext size 0x400
0x40004400 USART2 size 0x400
0x40004800 USART3 size 0x400
0x40004C00 UART4 size 0x400
0x40005000 UART5 size 0x400
0x40005400 I2C1 size 0x400 — Inter-integrated circuit
0x40005800 I2C2 size 0x400
0x40005C00 USB size 0x400 — Universal serial bus full-speed device interface
0x40006400 CAN size 0x400 — Controller area network
0x40007000 PWR size 0x400 — Power control
0x40007400 DAC1 size 0x400 — Digital-to-analog converter
0x40007800 I2C3 size 0x400
0x40009800 DAC2 size 0x400
0x40010000 SYSCFG size 0x400 — System configuration controller
0x40010000 OPAMP size 0x400 — Operational Amplifier
0x40010000 COMP size 0x400 — General purpose comparators
0x40010400 EXTI size 0x400 — External interrupt/event controller
0x40012C00 TIM1 size 0x400 — Advanced timer
0x40013000 SPI1 size 0x400 — Serial peripheral interface/Inter-IC sound
0x40013400 TIM8 size 0x400 — Advanced-timers
0x40013800 USART1 size 0x400 — Universal synchronous asynchronous receiver transmitter
0x40013C00 SPI4 size 0x400
0x40014000 TIM15 size 0x400 — General purpose timers
0x40014400 TIM16 size 0x400 — General-purpose-timers
0x40014800 TIM17 size 0x400 — General purpose timer
0x40015000 TIM20 size 0x400
0x40020000 DMA1 size 0x400 — DMA controller 1
0x40020400 DMA2 size 0x400
0x40021000 RCC size 0x400 — Reset and clock control
0x40022000 FLASH size 0x400
0x40023000 CRC size 0x400 — cyclic redundancy check calculation unit
0x40024000 TSC size 0x400 — Touch sensing controller
0x48000000 GPIOA size 0x400 — General-purpose I/Os
0x48000400 GPIOB size 0x400 — General-purpose I/Os
0x48000800 GPIOC size 0x400 — General-purpose I/Os
0x48000C00 GPIOD size 0x400
0x48001000 GPIOE size 0x400
0x48001400 GPIOF size 0x400
0x48001800 GPIOG size 0x400
0x48001C00 GPIOH size 0x400
0x50000000 ADC1 size 0x100 — Analog-to-Digital Converter
0x50000100 ADC2 size 0x100
0x50000300 ADC1_2 size 0x11 — Analog-to-Digital Converter
0x50000400 ADC3 size 0x100
0x50000500 ADC4 size 0x100
0x50000700 ADC3_4 size 0x11
0xA0000400 FMC size 0xC00 — Flexible memory controller
0xE000E008 SCB_ACTRL size 0x5 — System control block ACTLR
0xE000E010 STK size 0x11 — SysTick timer
0xE000E100 NVIC size 0x355 — Nested Vectored Interrupt Controller
0xE000ED00 SCB size 0x41 — System control block
0xE000ED88 FPU_CPACR size 0x5 — Floating point unit CPACR
0xE000ED90 MPU size 0x15 — Memory protection unit
0xE000EF00 NVIC_STIR size 0x5 — Nested vectored interrupt controller
0xE000EF34 FPU size 0xD — Floting point unit
0xE0042000 DBGMCU size 0x400 — Debug support

## Interrupts
0 WWDG — Window Watchdog interrupt
1 PVD (PWR) — PVD through EXTI line detection interrupt
2 TAMP_STAMP (EXTI) — Tamper and TimeStamp interrupts
3 RTC_WKUP (RTC) — RTC Wakeup interrupt through the EXTI line
4 FLASH — Flash global interrupt
5 RCC — RCC global interrupt
6 EXTI0 (EXTI) — EXTI Line0 interrupt
7 EXTI1 (EXTI) — EXTI Line3 interrupt
8 EXTI2_TSC (TSC, EXTI) — EXTI Line2 and Touch sensing interrupts
9 EXTI3 (EXTI) — EXTI Line3 interrupt
10 EXTI4 (EXTI) — EXTI Line4 interrupt
11 DMA1_CH1 (DMA1) — DMA1 channel 1 interrupt
12 DMA1_CH2 (DMA1) — DMA1 channel 2 interrupt
13 DMA1_CH3 (DMA1) — DMA1 channel 3 interrupt
14 DMA1_CH4 (DMA1) — DMA1 channel 4 interrupt
15 DMA1_CH5 (DMA1) — DMA1 channel 5 interrupt
16 DMA1_CH6 (DMA1) — DMA1 channel 6 interrupt
17 DMA1_CH7 (DMA1) — DMA1 channel 7interrupt
18 ADC1_2 (ADC1, ADC2) — ADC1 and ADC2 global interrupt
19 USB_HP_CAN_TX (CAN) — USB High Priority/CAN_TX interrupts
20 USB_LP_CAN_RX0 (CAN) — USB Low Priority/CAN_RX0 interrupts
21 CAN_RX1 (CAN) — CAN_RX1 interrupt
22 CAN_SCE (CAN) — CAN_SCE interrupt
23 EXTI9_5 (EXTI) — EXTI Line5 to Line9 interrupts
24 TIM1_BRK_TIM15 (TIM15) — TIM1 Break/TIM15 global interruts
25 TIM1_UP_TIM16 (TIM16) — TIM1 Update/TIM16 global interrupts
26 TIM1_TRG_COM_TIM17 (TIM17) — TIM1 trigger and commutation/TIM17 interrupts
27 TIM1_CC (TIM1, TIM20) — TIM1 capture compare interrupt
28 TIM2 — TIM2 global interrupt
29 TIM3 — TIM3 global interrupt
30 TIM4 — TIM4 global interrupt
31 I2C1_EV_EXTI23 (EXTI, I2C1) — I2C1 event interrupt and EXTI Line23 interrupt
32 I2C1_ER (I2C1) — I2C1 error interrupt
33 I2C2_EV_EXTI24 (I2C2, I2C3) — I2C2 event interrupt & EXTI Line24 interrupt
34 I2C2_ER (I2C2, I2C3) — I2C2 error interrupt
35 SPI1 — SPI1 global interrupt
36 SPI2 — SPI2 global interrupt
37 USART1_EXTI25 (USART1, EXTI) — USART1 global interrupt and EXTI Line 25 interrupt
38 USART2_EXTI26 (USART2, EXTI) — USART2 global interrupt and EXTI Line 26 interrupt
39 USART3_EXTI28 (USART3, EXTI) — USART3 global interrupt and EXTI Line 28 interrupt
40 EXTI15_10 (EXTI) — EXTI Line15 to Line10 interrupts
41 RTCAlarm (RTC) — RTC alarm interrupt
42 USB_WKUP (USB) — USB wakeup from Suspend
43 TIM8_BRK (TIM8) — TIM8 break interrupt
44 TIM8_UP (TIM8) — TIM8 update interrupt
45 TIM8_TRG_COM (TIM8) — TIM8 Trigger and commutation interrupts
46 TIM8_CC (TIM8) — TIM8 capture compare interrupt
47 ADC3 — ADC3 global interrupt
48 FMC — FSMC global interrupt
51 SPI3 (SPI3, SPI4) — SPI3 global interrupt
52 UART4_EXTI34 (UART4, EXTI) — UART4 global and EXTI Line 34 interrupts
53 UART5_EXTI35 (UART5, EXTI) — UART5 global and EXTI Line 35 interrupts
54 TIM6_DACUNDER (TIM6, DAC1) — TIM6 global and DAC12 underrun interrupts
55 TIM7 — TIM7 global interrupt
56 DMA2_CH1 (DMA2) — DMA2 channel1 global interrupt
57 DMA2_CH2 (DMA2) — DMA2 channel2 global interrupt
58 DMA2_CH3 (DMA2) — DMA2 channel3 global interrupt
59 DMA2_CH4 (DMA2) — DMA2 channel4 global interrupt
60 DMA2_CH5 (DMA2) — DMA2 channel5 global interrupt
61 ADC4 — ADC4 global interrupt
64 COMP123 (SYSCFG) — COMP1 & COMP2 & COMP3 interrupts combined with EXTI Lines 21, 22 and 29 interrupts
64 COMP1_2_3 (COMP) — COMP1_2_3 interrupt combined with EXTI lines 21, 22, 29
65 COMP456 (SYSCFG) — COMP4 & COMP5 & COMP6 interrupts combined with EXTI Lines 30, 31 and 32 interrupts
65 COMP4_5_6 (COMP) — COMP4_5_6 interrupt combined with EXTI lines 30, 31, 32
66 COMP7 (SYSCFG, COMP) — COMP7 interrupt combined with EXTI Line 33 interrupt
72 I2C3_EV (I2C3) — I2C3 Event interrupt
73 I2C3_ER (I2C3) — I2C3 Error interrupt
74 USB_HP (USB) — USB High priority interrupt
75 USB_LP (USB) — USB Low priority interrupt
76 USB_WKUP_EXTI (EXTI) — USB wakeup from Suspend and EXTI Line 18
77 TIM20_BRK (TIM20) — TIM20 Break interrupt
78 TIM20_UP (TIM20) — TIM20 Upgrade interrupt
79 TIM20_TRG_COM (TIM20) — TIM20 Trigger and Commutation interrupt
80 TIM20_CC (TIM20) — TIM20 Capture Compare interrupt
81 FPU — Floating point unit
84 SPI4 — SPI4 Global interrupt
